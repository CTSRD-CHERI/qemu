## hw/mips/Kconfig
```kconfig
config R4K
    bool

config MALTA
    bool


config CHERI128
    bool

config CHERI256
    bool

config CHERI128_MAGIC
    bool

config MIPSSIM
    bool

config JAZZ
    bool

config FULONG
    bool

config MIPS_CPS
    bool
    select PTIMER

config MIPS_BOSTON
    bool
```
